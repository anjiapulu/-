/*-----------------------------------------------
  名称：舵机控制	
  论坛：www.doflye.net
  编写：shifang
  日期：2009.5
  修改：无
  内容：通过按键调整舵机角度，舵机参数： 20ms周期，高电平时间从0.5ms~2.5ms,最大范围，根据不同舵机调整
------------------------------------------------*/
#include<reg52.h>
#include "delay.h"

sbit OUT = P2^3;

unsigned char TH_H,TL_H,TH_L,TL_L;//

unsigned char KeyScan(void);
/*------------------------------------------------
                    定时器初始化子程序
------------------------------------------------*/
void Init_Timer0(void)
{
 TMOD |= 0x01;	  //使用模式1，16位定时器，使用"|"符号可以在使用多个定时器时不受影响	TOMD = TOMD | 0X01	     
 TH0=0x00;	      //给定初值，这里使用定时器最大值从0开始计数一直到65535溢出
 TL0=0x00;
 EA=1;            //总中断打开
 ET0=1;           //定时器中断打开
 TR2=1;           //定时器开关打开
}
/*------------------------------------------------
                 数据处理
------------------------------------------------*/
void DataPro(unsigned int temp)
{
 	 TH_H=(65536-temp)/256;
   TL_H=(65536-temp)%256;
	 TH_L=(46536+temp)/256;
	 TL_L=(46536+temp)%256;
}
/*------------------------------------------------
                 主程序
------------------------------------------------*/
main()
{
  unsigned char keynum;
  unsigned int  temp=1500;
  Init_Timer0();
  DataPro(temp);

  while(1)
     {
	  keynum=KeyScan();
	  if(keynum==3)
	    {
		 if(temp<2300)
		 temp+=100;
     DataPro(temp);
		}
	  else if(keynum==4)
	   {
	     if(temp>600)
		   temp-=100;
		 DataPro(temp);
	   }
	 }
}

/*------------------------------------------------
                 定时器中断子程序
------------------------------------------------*/
void Timer2_isr(void) interrupt 5
{
if(OUT)
 {
 TH2=TH_L;		  //重新赋值
 TL2=TL_L;
 }
else
 {
  TH2=TH_H;		  //重新赋值
  TL2=TL_H;
  }
OUT=!OUT;
}

